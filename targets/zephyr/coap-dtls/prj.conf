## prj.conf
```kconfig
# Wi-Fi Configuration
CONFIG_WIFI=y

# Network Configuration
CONFIG_NET_CONFIG_AUTO_INIT=n
CONFIG_NET_CONNECTION_MANAGER=y
CONFIG_NET_DHCPV4=y
CONFIG_NET_IF_MAX_IPV4_COUNT=2
CONFIG_NET_IF_MAX_IPV6_COUNT=2
CONFIG_NET_IPV4=y
CONFIG_NET_L2_ETHERNET=y
CONFIG_NET_L2_WIFI_MGMT=y
CONFIG_NET_MGMT=y
CONFIG_NET_MGMT_EVENT=y
CONFIG_NET_MGMT_EVENT_INFO=y
CONFIG_NET_MGMT_EVENT_QUEUE_SIZE=10
CONFIG_NET_MGMT_EVENT_STACK_SIZE=4096
CONFIG_NET_PKT_RX_COUNT=16
CONFIG_NET_PKT_TX_COUNT=16
CONFIG_NET_SOCKETS_SERVICE_STACK_SIZE=4096
CONFIG_NET_TCP=y
CONFIG_NET_UDP=y
CONFIG_NETWORKING=y
CONFIG_ESP32_WIFI_STA_AUTO_DHCPV4=y

CONFIG_REQUIRES_FULL_LIBC=y
CONFIG_NET_IPV6=y
CONFIG_NET_SOCKETS=y
CONFIG_ZVFS_POLL_MAX=4
CONFIG_POSIX_API=y
CONFIG_COAP=y
CONFIG_CBPRINTF_FP_SUPPORT=y

# LOG Configuration
CONFIG_NET_LOG=y
CONFIG_NET_DHCPV4_SERVER_LOG_LEVEL_DBG=y

# Enable DTLS support for CoAP
CONFIG_NET_SOCKETS_ENABLE_DTLS=y
CONFIG_NET_SOCKETS_SOCKOPT_TLS=y

# Enable mbedTLS with comprehensive configuration
CONFIG_MBEDTLS=y
CONFIG_MBEDTLS_BUILTIN=y
CONFIG_MBEDTLS_ENABLE_HEAP=y
CONFIG_MBEDTLS_HEAP_SIZE=65536
CONFIG_MBEDTLS_SSL_MAX_CONTENT_LEN=16384
CONFIG_MBEDTLS_PEM_CERTIFICATE_FORMAT=y
CONFIG_MBEDTLS_SERVER_NAME_INDICATION=y
CONFIG_MBEDTLS_AES_ROM_TABLES=y
CONFIG_MBEDTLS_TLS_VERSION_1_2=y
CONFIG_MBEDTLS_MEMORY_DEBUG=y
CONFIG_MBEDTLS_HAVE_TIME_DATE=y

# Enable TLS credentials
CONFIG_TLS_CREDENTIALS=y
CONFIG_TLS_CREDENTIAL_FILENAMES=y

# DTLS socket configurations
CONFIG_NET_SOCKETS_TLS_MAX_CONTEXTS=4
CONFIG_NET_SOCKETS_TLS_MAX_CREDENTIALS=8

CONFIG_ENTROPY_GENERATOR=y
CONFIG_TEST_RANDOM_GENERATOR=y
```

## src/main.c
```c
#include <zephyr/kernel.h>
#include <zephyr/logging/log.h>

LOG_MODULE_REGISTER(coap_client, LOG_LEVEL_DBG);

#include <zephyr/net/net_mgmt.h>
#include <zephyr/net/socket.h>
#include <zephyr/net/wifi_mgmt.h>

#include "config.h"
#include "wifi.h"
#include "certs.h"
#include <zephyr/net/coap.h>
#include <zephyr/net/net_if.h>
#include <zephyr/net/net_ip.h>
#include <zephyr/net/net_mgmt.h>
#include <zephyr/net/socket.h>
#include <zephyr/net/udp.h>
#include <zephyr/random/random.h>

// TLS/SSL specific headers
#include <zephyr/net/tls_credentials.h>
#include <zephyr/net/net_ip.h>
#include <zephyr/net/net_core.h>

// mbedTLS headers for advanced TLS functionality
#include <mbedtls/ssl.h>
#include <mbedtls/entropy.h>
#include <mbedtls/ctr_drbg.h>
#include <mbedtls/error.h>
#include <mbedtls/debug.h>

static struct net_if *sta_iface;

#define TLS_HOST_NAME "test.com"

/* CoAP client socket */
static int coap_sock = -1;
static struct sockaddr_in magistrala_addr;

// TLS security tags for mutual authentication
static sec_tag_t tls_sec_tags[] = {
    TLS_TAG_CA_CERT,
    TLS_TAG_CLIENT_CERT,
    TLS_TAG_CLIENT_KEY,
};

#define MAX_COAP_MSG_LEN 512
#define TELEMETRY_INTERVAL_SEC 30

typedef struct {
  double temperature;
  double humidity;
  int battery_level;
  bool led_state;
} sensor_data_t;

static sensor_data_t current_data = {.temperature = 23.5,
                                     .humidity = 65.0,
                                     .battery_level = 85,
                                     .led_state = false};

static uint16_t message_id = 1;

/* Network event callback */
static struct net_mgmt_event_callback mgmt_cb;
static K_SEM_DEFINE(dhcp_sem, 0, 1);

static void net_mgmt_event_handler(struct net_mgmt_event_callback *cb,
                                   uint32_t mgmt_event, struct net_if *iface) {
  if (mgmt_event == NET_EVENT_IPV4_DHCP_BOUND) {
    LOG_INF("DHCP bound - got IP address");
    k_sem_give(&dhcp_sem);
  }
}

static int coap_client_init(void) {
  int ret;

  LOG_INF("Initializing CoAP DTLS client with mutual authentication...");

  /* Create DTLS socket */
  coap_sock = socket(AF_INET, SOCK_DGRAM, IPPROTO_DTLS_1_2);
  if (coap_sock < 0) {
    LOG_ERR("Failed to create CoAP DTLS socket: %d", errno);
    return -errno;
  }

  LOG_INF("DTLS socket created successfully");

  /* Configure TLS credentials for mutual authentication */
  ret = setsockopt(coap_sock, SOL_TLS, TLS_SEC_TAG_LIST, tls_sec_tags,
                   sizeof(tls_sec_tags));
  if (ret < 0) {
    LOG_ERR("Failed to set TLS security tags: %d", errno);
    close(coap_sock);
    return -errno;
  }
  LOG_INF("TLS security tags configured: CA cert, client cert, client key");

  /* Set TLS hostname for SNI */
  ret = setsockopt(coap_sock, SOL_TLS, TLS_HOSTNAME, TLS_HOST_NAME,
                   strlen(TLS_HOST_NAME));
  if (ret < 0) {
    LOG_ERR("Failed to set TLS hostname: %d", errno);
    close(coap_sock);
    return -errno;
  }
  LOG_INF("TLS hostname set to: %s", TLS_HOST_NAME);

  /* Configure DTLS-specific options */
  int dtls_enabled = 1;
  ret = setsockopt(coap_sock, SOL_TLS, TLS_DTLS_CID, &dtls_enabled,
                   sizeof(dtls_enabled));
  if (ret < 0) {
    LOG_WRN("Failed to enable DTLS Connection ID: %d", errno);
    // Continue without CID - not critical for basic functionality
  } else {
    LOG_INF("DTLS Connection ID enabled");
  }

  /* Disable peer verification for IP-based connections */
  int peer_verify = TLS_PEER_VERIFY_NONE;
  ret = setsockopt(coap_sock, SOL_TLS, TLS_PEER_VERIFY, &peer_verify,
                   sizeof(peer_verify));
  if (ret < 0) {
    LOG_WRN("Failed to set peer verification: %d", errno);
  } else {
    LOG_INF("Peer verification disabled for IP connection");
  }

  memset(&magistrala_addr, 0, sizeof(magistrala_addr));
  magistrala_addr.sin_family = AF_INET;
  magistrala_addr.sin_port = htons(MAGISTRALA_COAP_PORT);

  ret = inet_pton(AF_INET, MAGISTRALA_IP, &magistrala_addr.sin_addr);
  if (ret != 1) {
    LOG_ERR("Invalid IP address: %s", MAGISTRALA_IP);
    close(coap_sock);
    return -EINVAL;
  }

  LOG_INF("Magistrala CoAP DTLS client initialized successfully");
  LOG_INF("Target: %s:%d (mutual TLS authentication)", MAGISTRALA_IP, MAGISTRALA_COAP_PORT);

  return 0;
}

static int send_coap_message(const char *uri_path, const char *payload,
                             size_t payload_len) {
  static uint8_t request_buf[MAX_COAP_MSG_LEN];
  static uint8_t response_buf[MAX_COAP_MSG_LEN];
  struct coap_packet request, response;
  int ret, recv_len;
  struct sockaddr_in recv_addr;
  socklen_t recv_addr_len = sizeof(recv_addr);

  LOG_INF("Sending CoAP message to: %s", uri_path);

  /* Initialize CoAP request */
  ret = coap_packet_init(&request, request_buf, sizeof(request_buf),
                         COAP_VERSION_1, COAP_TYPE_CON, COAP_TOKEN_MAX_LEN,
                         coap_next_token(), COAP_METHOD_POST, coap_next_id());
  if (ret < 0) {
    LOG_ERR("Failed to init CoAP request: %d", ret);
    return ret;
  }

  /* Add URI path */
  ret = coap_packet_append_option(&request, COAP_OPTION_URI_PATH, uri_path,
                                  strlen(uri_path));
  if (ret < 0) {
    LOG_ERR("Failed to add URI path: %d", ret);
    return ret;
  }

  /* Add authorization header with Client secret */
  char auth_query[128];
  ret = snprintf(auth_query, sizeof(auth_query), "auth=%s", CLIENT_SECRET);
  if (ret >= sizeof(auth_query)) {
    LOG_ERR("URI path too large");
    return -E2BIG;
  }

  ret = coap_packet_append_option(&request, COAP_OPTION_URI_QUERY, auth_query,
                                  strlen(auth_query));
  if (ret < 0) {
    LOG_ERR("Failed to add auth query: %d", ret);
    return ret;
  }

  /* Add content format for JSON */
  if (payload && payload_len > 0) {
    /* Add payload */
    ret = coap_packet_append_payload_marker(&request);
    if (ret < 0) {
      LOG_ERR("Failed to add payload marker: %d", ret);
      return ret;
    }

    ret = coap_packet_append_payload(&request, payload, payload_len);
    if (ret < 0) {
      LOG_ERR("Failed to add payload: %d", ret);
      return ret;
    }
  }

  /* Send request */
  ret = sendto(coap_sock, request_buf, request.offset, 0,
               (struct sockaddr *)&magistrala_addr, sizeof(magistrala_addr));
  if (ret < 0) {
    LOG_ERR("Failed to send CoAP DTLS request: %d", errno);
    return -errno;
  }

  LOG_INF("CoAP DTLS request sent to %s", uri_path);

  /* Wait for response (with timeout) */
  struct pollfd pfd = {.fd = coap_sock, .events = POLLIN};

  ret = poll(&pfd, 1, 5000); // 5 second timeout
  if (ret <= 0) {
    LOG_WRN("CoAP response timeout or error: %d", ret);
    return -ETIMEDOUT;
  }

  /* Receive response */
  recv_len = recvfrom(coap_sock, response_buf, sizeof(response_buf), 0,
                      (struct sockaddr *)&recv_addr, &recv_addr_len);
  if (recv_len < 0) {
    LOG_ERR("Failed to receive CoAP DTLS response: %d", errno);
    return -errno;
  }

  /* Parse response */
  ret = coap_packet_parse(&response, response_buf, recv_len, NULL, 0);
  if (ret < 0) {
    LOG_ERR("Failed to parse CoAP DTLS response: %d", ret);
    return ret;
  }

  uint8_t response_code = coap_header_get_code(&response);
  LOG_DBG("CoAP DTLS response code: %d", response_code);

  return 0;
}

static int wait_for_ip_address(void) {
  struct net_if_addr *if_addr;
  struct net_if *iface = net_if_get_default();
  int timeout_count = 0;
  const int max_timeout = 30; // 30 seconds max wait

  /* Check if we already have an IP */
  if_addr = net_if_ipv4_get_global_addr(iface, NET_ADDR_PREFERRED);
  if (if_addr) {
    char addr_str[NET_IPV4_ADDR_LEN];
    net_addr_ntop(AF_INET, &if_addr->address.in_addr, addr_str,
                  sizeof(addr_str));
    LOG_INF("Already have IP address: %s", addr_str);
    return 0;
  }

  LOG_INF("Waiting for IP address via DHCP...");

  /* Wait for DHCP with timeout */
  int ret = k_sem_take(&dhcp_sem, K_SECONDS(max_timeout));
  if (ret != 0) {
    LOG_ERR("Timeout waiting for DHCP - checking if we have IP anyway");

    /* Final check if we somehow got an IP */
    if_addr = net_if_ipv4_get_global_addr(iface, NET_ADDR_PREFERRED);
    if (!if_addr) {
      LOG_ERR("No IP address available");
      return -ETIMEDOUT;
    }
  }

  /* Verify we have a valid IP - add small delay for IP assignment */
  k_sleep(K_MSEC(100));
  if_addr = net_if_ipv4_get_global_addr(iface, NET_ADDR_PREFERRED);
  if (if_addr) {
    char addr_str[NET_IPV4_ADDR_LEN];
    net_addr_ntop(AF_INET, &if_addr->address.in_addr, addr_str,
                  sizeof(addr_str));
    LOG_INF("Got IP address: %s", addr_str);
    return 0;
  }

  LOG_ERR("Still no valid IP address");
  return -1;
}

static int send_telemetry(void) {
  char json_payload[256];
  int ret;

  ret = snprintf(json_payload, sizeof(json_payload),
                 "{"
                 "\"temperature\":%.1f,"
                 "\"humidity\":%.1f,"
                 "\"battery\":%d,"
                 "\"led_state\":%s,"
                 "\"timestamp\":%lld"
                 "}",
                 current_data.temperature, current_data.humidity,
                 current_data.battery_level,
                 current_data.led_state ? "true" : "false", k_uptime_get());

  if (ret >= sizeof(json_payload)) {
    LOG_ERR("JSON payload too large");
    return -E2BIG;
  }

  // Construct URI path: m/{domain_id}/c/{channel_id} --auth {client_secret}
  char uri_path[5];
  ret =
      snprintf(uri_path, sizeof(uri_path), "/a");
  if (ret >= sizeof(uri_path)) {
    LOG_ERR("URI path too large");
    return -E2BIG;
  }

  ret = send_coap_message(uri_path, json_payload, strlen(json_payload));
  if (ret < 0) {
    LOG_ERR("Failed to send telemetry: %d", ret);
    return ret;
  }

  LOG_INF("Telemetry sent: temp=%.2f °C, humidity=%.2f %%, battery=%d %%",
          current_data.temperature, current_data.humidity,
          current_data.battery_level);

  return 0;
}

int main(void) {
  LOG_INF("=== Magistrala CoAP DTLS Client with Mutual Authentication ===");
  LOG_INF("Starting initialization sequence...");

  k_sleep(K_SECONDS(5));

  /* Step 1: Initialize TLS certificates */
  LOG_INF("Step 1: Initializing mutual TLS certificates");
  int ret = certs_init();
  if (ret < 0) {
    LOG_ERR("Failed to initialize TLS certificates: %d", ret);
    return ret;
  }
  LOG_INF("✓ TLS certificates initialized successfully");

  /* Step 2: Initialize WiFi */
  LOG_INF("Step 2: Initializing WiFi connection");
  initialize_wifi();

  /* Setup network management callback for DHCP events */
  net_mgmt_init_event_callback(&mgmt_cb, net_mgmt_event_handler,
                               NET_EVENT_IPV4_DHCP_BOUND);
  net_mgmt_add_event_callback(&mgmt_cb);

  /* Get STA interface */
  sta_iface = net_if_get_wifi_sta();

  /* Step 3: Connect to WiFi */
  LOG_INF("Step 3: Connecting to WiFi network: %s", WIFI_SSID);
  ret = connect_to_wifi(sta_iface, WIFI_SSID, WIFI_PSK);
  if (ret) {
    LOG_ERR("Failed to connect to WiFi (%s): %d", WIFI_SSID, ret);
    return ret;
  }
  LOG_INF("✓ WiFi connected successfully");

  /* Step 4: Wait for IP address */
  LOG_INF("Step 4: Waiting for IP address via DHCP");
  ret = wait_for_ip_address();
  if (ret < 0) {
    LOG_ERR("Failed to get IP address: %d", ret);
    return ret;
  }
  LOG_INF("✓ IP address obtained successfully");

  /* Step 5: Initialize CoAP DTLS client */
  LOG_INF("Step 5: Initializing CoAP DTLS client");
  ret = coap_client_init();
  if (ret < 0) {
    LOG_ERR("Failed to initialize CoAP DTLS client: %d", ret);
    return ret;
  }
  LOG_INF("✓ CoAP DTLS client initialized successfully");

  /* Step 6: Start telemetry transmission */
  LOG_INF("Step 6: Starting telemetry transmission");
  LOG_INF("Target: %s:%d (CoAPS with mutual TLS)", MAGISTRALA_IP, MAGISTRALA_COAP_PORT);
  LOG_INF("Telemetry interval: %d seconds", TELEMETRY_INTERVAL_SEC);

  /* Send initial telemetry */
  ret = send_telemetry();
  if (ret < 0) {
    LOG_ERR("Failed to send initial telemetry: %d", ret);
    LOG_WRN("Continuing with periodic transmission...");
  } else {
    LOG_INF("✓ Initial telemetry sent successfully");
  }

  /* Continuous operation loop */
  LOG_INF("=== Entering continuous operation mode ===");
  while (1) {
    k_sleep(K_SECONDS(TELEMETRY_INTERVAL_SEC));
    
    LOG_INF("Sending periodic telemetry...");
    ret = send_telemetry();
    if (ret < 0) {
      LOG_ERR("Failed to send periodic telemetry: %d", ret);
      LOG_WRN("Will retry in next cycle");
    } else {
      LOG_INF("✓ Periodic telemetry sent successfully");
    }
  }

  return 0;
}
```

## src/certs.h
```c
#ifndef CERTS_H
#define CERTS_H

#include <zephyr/kernel.h>
#include <zephyr/logging/log.h>
#include <zephyr/net/tls_credentials.h>

// TLS security tags for mutual TLS authentication
#define TLS_TAG_CA_CERT 1
#define TLS_TAG_CLIENT_CERT 2
#define TLS_TAG_CLIENT_KEY 3

// CA Certificate
static const char ca_cert[] = 
    "-----BEGIN CERTIFICATE-----\n"
    "MIICNTCCAdygAwIBAgIPAQIDBAUGBwgJCgsMDQ4PMAoGCCqGSM49BAMCMFMxCzAJ\n"
    "BgNVBAYTAkJSMQ8wDQYDVQQIEwZQYXJhbmExETAPBgNVBAcTCEN1cml0aWJhMQ0w\n"
    "CwYDVQQKEwRUZXN0MREwDwYDVQQDEwh0ZXN0LmNvbTAeFw0yNTA5MTAwODEwMjZa\n"
    "Fw0yNTA5MTAwOTEwMjZaMFMxCzAJBgNVBAYTAkJSMQ8wDQYDVQQIEwZQYXJhbmEx\n"
    "ETAPBgNVBAcTCEN1cml0aWJhMQ0wCwYDVQQKEwRUZXN0MREwDwYDVQQDEwh0ZXN0\n"
    "LmNvbTBZMBMGByqGSM49AgEGCCqGSM49AwEHA0IABFFcPW6545a5BNP+yn9U/c0M\n"
    "wemXvzddylFa0KbDtANfRTa+OlDzGPv5pUdZAqIhUCvvDVfgjFOyzApW8X2fk1Sj\n"
    "gZIwgY8wDgYDVR0PAQH/BAQDAgKEMB0GA1UdJQQWMBQGCCsGAQUFBwMCBggrBgEF\n"
    "BQcDATAPBgNVHRMBAf8EBTADAQH/MB0GA1UdDgQWBBRCaYiUMeMTGWb8r2pFcUGU\n"
    "PtLDWzAuBgNVHREEJzAlgQtjYUB0ZXN0LmNvbYcEfwAAAYcQAAAAAAAAAAAAAAAA\n"
    "AAAAATAKBggqhkjOPQQDAgNHADBEAiBL3l0pOMOv/JRYhaMW5tYAANaCVuV8UxHb\n"
    "GhaWkIDS5AIgRpVFWY9yUjPBqpkaBKJ6HfxAVtYidpM7Ix0QtX1jgJw=\n"
    "-----END CERTIFICATE-----\n";

static const size_t ca_cert_len = sizeof(ca_cert);

// Client Certificate
static const char client_cert[] = 
    "-----BEGIN CERTIFICATE-----\n"
    "MIICGTCCAb+gAwIBAgIQPxyp2HjLMSgTPQWGI/rX5DAKBggqhkjOPQQDAjBTMQsw\n"
    "CQYDVQQGEwJCUjEPMA0GA1UECBMGUGFyYW5hMREwDwYDVQQHEwhDdXJpdGliYTEN\n"
    "MAsGA1UEChMEVGVzdDERMA8GA1UEAxMIdGVzdC5jb20wHhcNMjUwOTEwMDgxMDI2\n"
    "WhcNMjUwOTEwMDkxMDI2WjBTMQswCQYDVQQGEwJCUjEPMA0GA1UECBMGUGFyYW5h\n"
    "MREwDwYDVQQHEwhDdXJpdGliYTENMAsGA1UEChMEVGVzdDERMA8GA1UEAxMIdGVz\n"
    "dC5jb20wWTATBgcqhkjOPQIBBggqhkjOPQMBBwNCAASn3z2iLvgsONyy3YLwFtAG\n"
    "SJ1F/7n5b2aMtv9YqOF0QTLBZ+EzLv9tzws6CN8ldlD83QgD9fLkz+rXXfOWrNRf\n"
    "o3UwczAOBgNVHQ8BAf8EBAMCB4AwHQYDVR0lBBYwFAYIKwYBBQUHAwIGCCsGAQUF\n"
    "BwMBMA4GA1UdDgQHBAUBAgMEBjAyBgNVHREEKzApgQ9jbGllbnRAdGVzdC5jb22H\n"
    "BH8AAAGHEAAAAAAAAAAAAAAAAAAAAAEwCgYIKoZIzj0EAwIDSAAwRQIgJbCP2/mR\n"
    "V080adSG+7AkoCny2WWbS8datU0x8kFOvi0CIQCf3N8uYY7eCVZSzPrWpBSDwJLG\n"
    "Ky05u7yja8m88wQayA==\n"
    "-----END CERTIFICATE-----\n";

static const size_t client_cert_len = sizeof(client_cert);

// Client Private Key
static const char client_key[] =
    "-----BEGIN EC PRIVATE KEY-----\n"
    "MIGHAgEAMBMGByqGSM49AgEGCCqGSM49AwEHBG0wawIBAQQg4b9jAE6iNA3Nsm04\n"
    "gkLWq4FaGVmtuUM2SfMcgfsYArmhRANCAASn3z2iLvgsONyy3YLwFtAGSJ1F/7n5\n"
    "b2aMtv9YqOF0QTLBZ+EzLv9tzws6CN8ldlD83QgD9fLkz+rXXfOWrNRf\n"
    "-----END EC PRIVATE KEY-----\n";
static const size_t client_key_len = sizeof(client_key);

static bool certs_initialized = false;

/**
 * @brief Initialize TLS certificates for mutual authentication
 */
static inline int certs_init(void)
{
    int ret;
    
    if (certs_initialized) {
        LOG_INF("Certificates already initialized");
        return 0;
    }
    
    LOG_INF("Initializing mutual TLS certificates...");
    
    // Add the CA certificate
    ret = tls_credential_add(TLS_TAG_CA_CERT, TLS_CREDENTIAL_NONE,
                            ca_cert, ca_cert_len);
    if (ret < 0) {
        LOG_ERR("Failed to add CA certificate: %d", ret);
        return ret;
    }
    LOG_INF("CA certificate added successfully");
    
    // Add the client certificate
    ret = tls_credential_add(TLS_TAG_CLIENT_CERT, TLS_CREDENTIAL_SERVER_CERTIFICATE,
                            client_cert, client_cert_len);
    if (ret < 0) {
        LOG_ERR("Failed to add client certificate: %d", ret);
        return ret;
    }
    LOG_INF("Client certificate added successfully");
    
    // Add the client private key
    ret = tls_credential_add(TLS_TAG_CLIENT_KEY, TLS_CREDENTIAL_PRIVATE_KEY,
                            client_key, client_key_len);
    if (ret < 0) {
        LOG_ERR("Failed to add client private key: %d", ret);
        return ret;
    }
    LOG_INF("Client private key added successfully");
    
    certs_initialized = true;
    LOG_INF("Mutual TLS certificates initialized successfully");
    
    return 0;
}

#endif /* CERTS_H */
```

## src/config.h
```c
#ifndef CONFIG_H
#define CONFIG_H

/* STA Mode Configuration */
#define WIFI_SSID "SSID"    // Replace `SSID` with WiFi ssid
#define WIFI_PSK "PASSWORD" // Replace `PASSWORD` with Router password

/* Magistrala Configuration */
#define MAGISTRALA_IP                                                          \
  "192.168.8.126" // Replace with your Magistrala instance IP
#define MAGISTRALA_COAP_PORT 5688  // DTLS port for CoAPS (CoAP over DTLS)
#define DOMAIN_ID "37e191d5-0e57-4d27-b384-26f3c1439561"         // Replace with your Domain ID
#define CLIENT_ID "c658801e-ef14-4aca-a024-7fa034e95624"         // Replace with your Client ID
#define CLIENT_SECRET "316377fe-a105-4afa-85fb-ca020255c5dc" // Replace with your Client secret
#define CHANNEL_ID "6f81fcb4-0751-414e-a1ce-912045d0a1c7"       // Replace with your Channel ID
#define MQTT_CLIENTID "c658801e-ef14-4aca-a024-7fa034e95624" // Replace with your actual client ID

#endif
```
